#include "ssd1306.h"
#include "i2c.h"
#include <string.h>

// 6x8 字库（ASCII 32~126）
static const uint8_t Font6x8[][6] = {
    {0x00,0x00,0x00,0x00,0x00,0x00}, // 空格
    {0x00,0x00,0x00,0x2F,0x00,0x00}, // !
    {0x00,0x00,0x07,0x00,0x07,0x00}, // "
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    {0x00,0x02,0x01,0x02,0x01,0x02}  // ~
};

// 当前光标位置
static uint8_t cursor_x = 0;
static uint8_t cursor_page = 0;

// ============================================================
// ★★★ 关键：去掉 static，让其他文件可以调用 ★★★
// ============================================================
void SSD1306_WriteCmd(uint8_t cmd) {
    uint8_t buf[2] = {0x00, cmd};
    HAL_I2C_Master_Transmit(&hi2c1, SSD1306_ADDR << 1, buf, 2, HAL_MAX_DELAY);
}

// 写数据（保持 static，仅供内部使用）
static void SSD1306_WriteData(uint8_t dat) {
    uint8_t buf[2] = {0x40, dat};
    HAL_I2C_Master_Transmit(&hi2c1, SSD1306_ADDR << 1, buf, 2, HAL_MAX_DELAY);
}

// ============================================================
// 初始化序列
// ============================================================
void SSD1306_Init(void) {
    HAL_Delay(100);
    SSD1306_WriteCmd(0xAE);
    SSD1306_WriteCmd(0xD5);  SSD1306_WriteCmd(0x80);
    SSD1306_WriteCmd(0xA8);  SSD1306_WriteCmd(0x3F);
    SSD1306_WriteCmd(0xD3);  SSD1306_WriteCmd(0x00);
    SSD1306_WriteCmd(0x40);
    SSD1306_WriteCmd(0x8D);  SSD1306_WriteCmd(0x14);
    SSD1306_WriteCmd(0x20);  SSD1306_WriteCmd(0x02);
    SSD1306_WriteCmd(0xA1);
    SSD1306_WriteCmd(0xC8);
    SSD1306_WriteCmd(0xDA);  SSD1306_WriteCmd(0x12);
    SSD1306_WriteCmd(0x81);  SSD1306_WriteCmd(0xCF);
    SSD1306_WriteCmd(0xD9);  SSD1306_WriteCmd(0xF1);
    SSD1306_WriteCmd(0xDB);  SSD1306_WriteCmd(0x40);
    SSD1306_WriteCmd(0xA4);
    SSD1306_WriteCmd(0xA6);
    SSD1306_WriteCmd(0x2E);
    SSD1306_WriteCmd(0xAF);
    SSD1306_Clear();
}

// ============================================================
// 清屏
// ============================================================
void SSD1306_Clear(void) {
    for (uint8_t page = 0; page < SSD1306_PAGES; page++) {
        SSD1306_WriteCmd(0xB0 + page);
        SSD1306_WriteCmd(0x00);
        SSD1306_WriteCmd(0x10);
        for (uint8_t col = 0; col < SSD1306_WIDTH; col++) {
            SSD1306_WriteData(0x00);
        }
    }
    cursor_x = 0;
    cursor_page = 0;
}

// ============================================================
// 设置光标位置
// ============================================================
void SSD1306_SetCursor(uint8_t x, uint8_t page) {
    cursor_x = x;
    cursor_page = page;
}

// ============================================================
// 写字符
// ============================================================
void SSD1306_WriteChar(char ch) {
    if (ch < 32 || ch > 126) ch = 32;
    for (uint8_t i = 0; i < 6; i++) {
        SSD1306_WriteCmd(0xB0 + cursor_page);
        SSD1306_WriteCmd(0x00 + (cursor_x % 16));
        SSD1306_WriteCmd(0x10 + (cursor_x / 16));
        SSD1306_WriteData(Font6x8[ch - 32][i]);
        cursor_x++;
    }
    SSD1306_WriteCmd(0xB0 + cursor_page);
    SSD1306_WriteCmd(0x00 + (cursor_x % 16));
    SSD1306_WriteCmd(0x10 + (cursor_x / 16));
    SSD1306_WriteData(0x00);
    cursor_x++;
}

// ============================================================
// 写字符串
// ============================================================
void SSD1306_WriteString(char *str) {
    while (*str) {
        SSD1306_WriteChar(*str++);
    }
}
